## boards/shields/banana/Kconfig.defconfig
```kconfig
if SHIELD_BANANA_LEFT

config ZMK_KEYBOARD_NAME
    default "banana"

config ZMK_SPLIT_ROLE_CENTRAL
    default y

endif

if SHIELD_BANANA_LEFT || SHIELD_BANANA_RIGHT

config ZMK_SPLIT
    default y

endif
```

## boards/shields/banana/Kconfig.shield
```kconfig
config SHIELD_BANANA_DONGLE
    def_bool $(shields_list_contains,banana_dongle)

config SHIELD_BANANA_LEFT
    def_bool $(shields_list_contains,banana_left)
  
config SHIELD_BANANA_RIGHT
    def_bool $(shields_list_contains,banana_right)
  
```

## config/west.yml
```yaml
manifest:
  remotes:
    - name: zmkfirmware
      url-base: https://github.com/zmkfirmware
    - name: austlai
      url-base: https://github.com/austlai
  projects:
    - name: zmk
      remote: zmkfirmware
      import: app/west.yml
      revision: v0.3
    - name: zmk-dongle-display
      remote: austlai
      revision: 1b402b9
  self:
    path: config
```
